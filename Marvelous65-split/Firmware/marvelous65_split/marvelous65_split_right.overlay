/*
 * Copyright (c) 2020 The ZMK Contributors
 *
 * SPDX-License-Identifier: MIT
 */

#include "marvelous65_split.dtsi"

&default_transform {
	col-offset = <8>;
};

/ {
    /* This kscan is for the 60% left half without macro keys the
     * macro pad layout may require different column and row pins
     */
    kscan0: kscan {
        compatible = "zmk,kscan-gpio-matrix";
        label = "KSCAN";
        diode-direction = "col2row";


        col-gpios
            = <&pro_micro_a  1 GPIO_ACTIVE_HIGH>
            , <&pro_micro_a  0 GPIO_ACTIVE_HIGH>
            , <&pro_micro_d  15 GPIO_ACTIVE_HIGH>
            , <&pro_micro_d  7 GPIO_ACTIVE_HIGH>
            , <&pro_micro_d  14 GPIO_ACTIVE_HIGH>
            , <&pro_micro_d  8 GPIO_ACTIVE_HIGH>
            , <&pro_micro_d  16 GPIO_ACTIVE_HIGH>
            , <&pro_micro_d  9 GPIO_ACTIVE_HIGH>
            
            ;

        row-gpios
            = <&pro_micro_d 1 (GPIO_ACTIVE_HIGH | GPIO_PULL_DOWN)>
            , <&pro_micro_a 3 (GPIO_ACTIVE_HIGH | GPIO_PULL_DOWN)>
            , <&pro_micro_a 2 (GPIO_ACTIVE_HIGH | GPIO_PULL_DOWN)>
            , <&pro_micro_d 6 (GPIO_ACTIVE_HIGH | GPIO_PULL_DOWN)>
            , <&pro_micro_d 10 (GPIO_ACTIVE_HIGH | GPIO_PULL_DOWN)>
            ;
    };
};


&right_encoder {
    status = "okay";
};