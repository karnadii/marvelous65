## Marvelou65-ergo/Firmware/marvelous65_ergo/Kconfig.shield
```kconfig
# Copyright (c) 2020 The ZMK Contributors
# SPDX-License-Identifier: MIT

config SHIELD_MARVELOUS65_ERGO
    def_bool $(shields_list_contains,marvelous65_ergo)
```

## Marvelous65-split/Firmware/marvelous65_split/Kconfig.shield
```kconfig
# Copyright (c) 2020 The ZMK Contributors
# SPDX-License-Identifier: MIT

config SHIELD_MARVELOUS65_SPLIT_LEFT
	def_bool $(shields_list_contains,marvelous65_split_left)

config SHIELD_MARVELOUS65_SPLIT_RIGHT
	def_bool $(shields_list_contains,marvelous65_split_right)
```

## Marvelous65/Firmware/marvelous65/Kconfig.shield
```kconfig
# Copyright (c) 2020 The ZMK Contributors
# SPDX-License-Identifier: MIT

config SHIELD_MARVELOUS65_REV2
    def_bool $(shields_list_contains,marvelous65_rev2)
```
